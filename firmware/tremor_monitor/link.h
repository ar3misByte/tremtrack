// Networking for the ESP32: everything that leaves the board other than the USB serial stream.
// Not compiled by the host simulator (HTM_HOSTSIM).
//
//   Bluetooth LE   Nordic-UART-style service; the phone app (Android Chrome, Web Bluetooth) reads the
//                  same '$' lines as USB and writes commands. Works with no Wi-Fi and no router.
//   LAN WebSocket  ws://<ip>:81, same lines and commands. For a laptop, or a phone on the same Wi-Fi.
//   AWS IoT Core   MQTT over TLS with this device's own certificate (device_config.h, generated by
//                  tools/aws/provision-device.mjs): a summary every 5 s (1 s while watched) and events.
//
// Everything here runs in its own FreeRTOS task on core 0. The sampling loop only copies a frame into a
// queue (never blocks), so a slow phone or a bad Wi-Fi link cannot disturb the 100 Hz detector.
//
// Commands (one line each; BLE write / WebSocket text / USB serial; the single digits 1-5 still work):
//   !sens N            sensitivity 1-5
//   !wifi SSID<TAB>PASSWORD   store Wi-Fi credentials (flash) and connect. Over BLE / WebSocket only
//                      within 10 minutes of power-up (or while none are stored): power-cycle to re-open.
//   !forget            delete the stored Wi-Fi credentials
//   !tz MINUTES        local time zone offset east of UTC (330 = India); the cloud uses it for local days
//   !fall OUTCOME      cancelled | confirmed | no-response: the phone's answer to a fall countdown
//   !recenter          yaw = 0
//   !info              prints a '# INFO ...' line
//   !reboot
#pragma once
#include <Arduino.h>
#include <WiFi.h>
#include <Preferences.h>
#include <time.h>
#include <sys/time.h>
#include <esp_system.h>
#include <esp_mac.h>
#include <freertos/FreeRTOS.h>
#include <freertos/queue.h>
#include <freertos/task.h>
#include <esp_bt.h>
#include <NimBLEDevice.h>
#include <WebSocketsServer.h>
#include "frame.h"
#include "reporter.h"

#if __has_include("device_config.h")
#include "device_config.h"
#define HTM_HAVE_CLOUD 1
#include "mqtt_client.h"
#else
#define HTM_HAVE_CLOUD 0
#endif

#define HTM_FW_VERSION "htm-0.8.2"
#define HTM_BLE_SERVICE "6e400001-b5a3-f393-e0a9-e50e24dcca9e"
#define HTM_BLE_RX      "6e400002-b5a3-f393-e0a9-e50e24dcca9e"   // phone -> device (write)
#define HTM_BLE_TX      "6e400003-b5a3-f393-e0a9-e50e24dcca9e"   // device -> phone (notify)
#define HTM_WS_PORT 81
#define HTM_OK_BUTTON_PIN 0                                       // the BOOT button: "I'm OK" for a fall countdown
#define HTM_WIFI_OPEN_MS 600000UL

bool htmCoreCommand(const char *line);                            // sketch: sens, recenter, compass, ...
int htmMagState();
const char *htmOrient();                                          // sketch: "+x+y+z"                                                // sketch: 0 none, 1 uncalibrated, 2 ignored now, 3 correcting, 4 calibrating

namespace lnk {

QueueHandle_t frameQ = nullptr;      // HtmFrame, from the sampling loop
QueueHandle_t statusQ = nullptr;     // char[kStatus], '# ...' lines for BLE / WebSocket clients
const int kStatus = 120;

Preferences prefs;
WebSocketsServer ws(HTM_WS_PORT);
bool wsStarted = false;
NimBLECharacteristic *bleTx = nullptr;
bool bleOn = false;                  // NimBLE is initialised (it is switched off while the TLS handshake to AWS runs: see the cloud phases)
volatile bool bleConnected = false;
volatile int bleMtu = 23;
char devName[24] = "HeadTremor";
String ssid, pass;
int tzMin = 330;
volatile bool timeSet = false;
bool wifiWanted = false;
htm::Reporter reporter;
bool reporterOn = false;
uint32_t dropped = 0;

#if HTM_HAVE_CLOUD
esp_mqtt_client_handle_t mqtt = nullptr;
volatile bool cloudUp = false;
char tTel[160], tEvt[160], tSta[160], tCmd[160], tView[160];
uint64_t watchUntil = 0;
uint64_t lastHeartbeat = 0;
bool bootSent = false;
// Bluetooth and the TLS handshake do not fit in RAM together, so they take turns:
//   TRY  Bluetooth off, connecting (30 s)  ->  UP  connected, Bluetooth back on
//   TRY timed out: stop, Bluetooth back on (the phone can still fix settings), WAIT 60 s, then TRY again
//   UP and the connection drops: Bluetooth off again and TRY (a reconnect needs the same RAM)
enum CloudPhase { CL_IDLE, CL_TRY, CL_UP, CL_WAIT };
CloudPhase cloudPhase = CL_IDLE;
uint32_t cloudDeadline = 0;
struct EventSlot { char json[420]; };
const int kEvq = 16;
EventSlot evq[kEvq];
int evHead = 0, evCount = 0;
#endif

inline uint64_t epochMs() { struct timeval tv; gettimeofday(&tv, nullptr); return (uint64_t)tv.tv_sec * 1000ULL + tv.tv_usec / 1000; }

/** Prints a '# ...' line on USB and sends it to connected phones. */
void status(const char *fmt, ...) {
  char b[kStatus];
  b[0] = '#'; b[1] = ' ';
  va_list ap; va_start(ap, fmt); vsnprintf(b + 2, sizeof b - 3, fmt, ap); va_end(ap);
  size_t n = strlen(b); b[n] = '\n'; b[n + 1] = 0;
  Serial.print(b);
  if (statusQ) xQueueSend(statusQ, b, 0);
}

String lineArg(const char *s, const char *prefix) { return String(s + strlen(prefix)); }

void connectWifi() {
  if (ssid.length() == 0) return;
  WiFi.mode(WIFI_STA);
  WiFi.setAutoReconnect(true);
  static bool hooked = false;
  if (!hooked) {
    hooked = true;
    static uint32_t lastReport = 0;
    WiFi.onEvent([](arduino_event_id_t, arduino_event_info_t info) {
      // reason 2/15/202 = wrong password, 201 = network not found (also 5 GHz-only networks), 205 = connection failed
      uint32_t t = millis();
      if (t - lastReport < 5000) return;
      lastReport = t;
      status("WIFI not connected, reason %d", (int)info.wifi_sta_disconnected.reason);
    }, ARDUINO_EVENT_WIFI_STA_DISCONNECTED);
    WiFi.onEvent([](arduino_event_id_t, arduino_event_info_t) { status("WIFI connected, ip %s rssi %d", WiFi.localIP().toString().c_str(), WiFi.RSSI()); }, ARDUINO_EVENT_WIFI_STA_GOT_IP);
  }
  WiFi.begin(ssid.c_str(), pass.c_str());
  configTime(0, 0, "pool.ntp.org", "time.google.com");
  wifiWanted = true;
  status("WIFI connecting to %s", ssid.c_str());
}

void info() {
  status("INFO fw=%s name=%s wifi=%s ip=%s rssi=%d cloud=%s time=%s tz=%d ble=%d ws=%d mag=%d orient=%s",
         HTM_FW_VERSION, devName, WiFi.status() == WL_CONNECTED ? "up" : (ssid.length() ? "down" : "unset"),
         WiFi.localIP().toString().c_str(), WiFi.status() == WL_CONNECTED ? WiFi.RSSI() : 0,
#if HTM_HAVE_CLOUD
         cloudUp ? "up" : "down",
#else
         "off",
#endif
         timeSet ? "ok" : "no", tzMin, (int)bleConnected, (int)(wsStarted ? ws.connectedClients() : 0), htmMagState(), htmOrient());
}

/** One command line from any channel. `trusted`: USB serial. */
void handle(const char *line, bool trusted) {
  while (*line == ' ') line++;
  if (!*line) return;
  if (line[0] != '!') { if (line[0] >= '1' && line[0] <= '5') htmCoreCommand(line); return; }
  if (!strncmp(line, "!wifi ", 6)) {
    if (!trusted && millis() > HTM_WIFI_OPEN_MS && ssid.length() > 0) { status("WIFI setup closed (power-cycle the board to allow it for 10 minutes)"); return; }
    String a = lineArg(line, "!wifi ");
    int tab = a.indexOf('\t');
    if (tab < 1) { status("WIFI usage: !wifi SSID<TAB>PASSWORD"); return; }
    ssid = a.substring(0, tab); pass = a.substring(tab + 1);
    pass.trim();
    prefs.putString("ssid", ssid); prefs.putString("pass", pass);
    WiFi.disconnect();
    connectWifi();
  } else if (!strcmp(line, "!forget")) {
    prefs.remove("ssid"); prefs.remove("pass"); ssid = ""; pass = ""; wifiWanted = false; WiFi.disconnect(true);
    status("WIFI credentials deleted");
  } else if (!strncmp(line, "!tz ", 4)) {
    int v = atoi(line + 4);
    if (v >= -720 && v <= 840) { tzMin = v; prefs.putInt("tz", v); status("TZ %d", v); }
  } else if (!strncmp(line, "!fall ", 6)) {
    const char *o = line + 6;
    if (reporterOn && (!strncmp(o, "cancelled", 9) || !strncmp(o, "confirmed", 9) || !strncmp(o, "no-response", 11))) {
      char out[16]; size_t k = 0; while (o[k] && o[k] != ' ' && o[k] != '\r' && o[k] != '\n' && k < 15) { out[k] = o[k]; k++; } out[k] = 0;
      reporter.fallOutcome(epochMs(), out);
    }
  } else if (!strcmp(line, "!info")) {
    info();
  } else if (!strcmp(line, "!reboot")) {
    status("REBOOT"); delay(200); esp_restart();
  } else {
    htmCoreCommand(line);
  }
}

// ---------------- BLE ----------------
class RxCb : public NimBLECharacteristicCallbacks {
  char buf[200]; size_t n = 0;
  void onWrite(NimBLECharacteristic *c, NimBLEConnInfo &) override {
    std::string v = c->getValue();
    for (char ch : v) {
      if (ch == '\n' || ch == '\r' || n >= sizeof buf - 1) { if (n) { buf[n] = 0; handle(buf, false); } n = 0; }
      else buf[n++] = ch;
    }
  }
};
class SrvCb : public NimBLEServerCallbacks {
  void onConnect(NimBLEServer *, NimBLEConnInfo &) override { bleConnected = true; }
  void onDisconnect(NimBLEServer *, NimBLEConnInfo &, int) override { bleConnected = false; bleMtu = 23; NimBLEDevice::startAdvertising(); }
  void onMTUChange(uint16_t mtu, NimBLEConnInfo &) override { bleMtu = mtu; }
};
RxCb rxCb; SrvCb srvCb;

/**
 * The 31-byte advertisement holds only the flags and the 128-bit service UUID (18 bytes), which is what the phone's
 * Bluetooth chooser filters on. The name goes in the scan response, so it fits however long it is.
 */
bool bleAdvertise() {
  NimBLEAdvertising *adv = NimBLEDevice::getAdvertising();
  NimBLEAdvertisementData ad, sr;
  ad.setFlags(BLE_HS_ADV_F_DISC_GEN | BLE_HS_ADV_F_BREDR_UNSUP);
  ad.addServiceUUID(HTM_BLE_SERVICE);
  sr.setName(devName);
  adv->setAdvertisementData(ad);
  adv->setScanResponseData(sr);
  adv->enableScanResponse(true);
  bool ok = adv->start();
  Serial.printf("# BLE advertising %s as \"%s\"\n", ok ? "started" : "FAILED to start", devName);
  return ok;
}

void bleBegin() {
  if (bleOn) return;
  // Only BLE is used: give the classic-Bluetooth controller's RAM back (tens of KB). Must run before BLE starts.
  static bool released = false;
  if (!released) { released = true; esp_bt_controller_mem_release(ESP_BT_MODE_CLASSIC_BT); }
  NimBLEDevice::init(devName);
  bleOn = true;
  NimBLEDevice::setMTU(247);
  NimBLEServer *srv = NimBLEDevice::createServer();
  srv->setCallbacks(&srvCb);
  NimBLEService *svc = srv->createService(HTM_BLE_SERVICE);
  bleTx = svc->createCharacteristic(HTM_BLE_TX, NIMBLE_PROPERTY::NOTIFY);
  NimBLECharacteristic *rx = svc->createCharacteristic(HTM_BLE_RX, NIMBLE_PROPERTY::WRITE | NIMBLE_PROPERTY::WRITE_NR);
  rx->setCallbacks(&rxCb);
  srv->start();                                   // NimBLE 2.x registers the GATT services here: without it no phone can find them
  bleAdvertise();
}
// Lines are packed into notifications of at most MTU-3 bytes.
char bleBuf[244]; size_t bleLen = 0;
void bleFlush() { if (bleLen && bleTx && bleConnected) bleTx->notify((const uint8_t *)bleBuf, bleLen); bleLen = 0; }
void bleSend(const char *line, size_t n) {
  if (!bleConnected || !bleTx) { bleLen = 0; return; }
  size_t cap = (size_t)(bleMtu > 3 ? bleMtu - 3 : 20); if (cap > sizeof bleBuf) cap = sizeof bleBuf;
  while (n) {
    if (bleLen == cap) bleFlush();
    size_t k = min(n, cap - bleLen);
    memcpy(bleBuf + bleLen, line, k); bleLen += k; line += k; n -= k;
  }
  if (bleLen > cap / 2) bleFlush();
}

/** Frees NimBLE's RAM (about 40 KB; a connected phone is disconnected). The TLS handshake to AWS needs ~55 KB at once and
 *  failed with mbedtls -0x7F00 (out of memory) when Bluetooth was up: heap 42 KB, largest block 28 KB. */
void bleStop() {
  if (!bleOn) return;
  bleOn = false; bleConnected = false; bleTx = nullptr; bleLen = 0; bleMtu = 23;
  NimBLEDevice::deinit(true);
  Serial.printf("# BLE off while the cloud connects (free heap %u)\n", (unsigned)ESP.getFreeHeap());
}

// ---------------- WebSocket ----------------
void wsEvent(uint8_t num, WStype_t type, uint8_t *payload, size_t len) {
  if (type == WStype_CONNECTED) { ws.sendTXT(num, "# Tremor Stream (WebSocket)\n"); }
  else if (type == WStype_TEXT && len < 200) { char b[200]; memcpy(b, payload, len); b[len] = 0; for (size_t i = 0; i < len; i++) if (b[i] == '\n' || b[i] == '\r') b[i] = 0; handle(b, false); }
}

// ---------------- Cloud ----------------
#if HTM_HAVE_CLOUD
void publish(const char *topic, const char *json, int qos, bool retain) {
  if (mqtt && cloudUp) esp_mqtt_client_publish(mqtt, topic, json, 0, qos, retain ? 1 : 0);
}
void publishStatus(bool online) {
  char j[200];
  snprintf(j, sizeof j, "{\"v\":1,\"online\":%s,\"ts\":%llu,\"fw\":\"%s\",\"tzMin\":%d,\"rate\":%.1f}", online ? "true" : "false", (unsigned long long)epochMs(), HTM_FW_VERSION, tzMin, reporter.period() == 1 ? 1.0 : 0.2);
  publish(tSta, j, 1, true);
  lastHeartbeat = millis();
}
long jsonNum(const char *s, const char *key, long dflt) {
  const char *p = strstr(s, key);
  if (!p) return dflt;
  p = strchr(p, ':');
  return p ? atol(p + 1) : dflt;
}
void onMqtt(void *, esp_event_base_t, int32_t id, void *data) {
  esp_mqtt_event_handle_t e = (esp_mqtt_event_handle_t)data;
  if (id == MQTT_EVENT_CONNECTED) {
    cloudUp = true;
    esp_mqtt_client_subscribe_single(mqtt, tCmd, 1);
    esp_mqtt_client_subscribe_single(mqtt, tView, 1);
    publishStatus(true);
    status("CLOUD connected");
  } else if (id == MQTT_EVENT_DISCONNECTED) {
    cloudUp = false;
    status("CLOUD disconnected");
  } else if (id == MQTT_EVENT_ERROR && e->error_handle) {
    // why a connection failed: TLS/socket error codes (-0x2700 = certificate verify failed, 118/113 = no route, 104 = reset) or the broker's refusal code
    const esp_mqtt_error_codes_t *er = e->error_handle;
    if (er->error_type == MQTT_ERROR_TYPE_TCP_TRANSPORT) status("CLOUD error tls=0x%x stack=-0x%x errno=%d fw=%s heap=%u block=%u ble=%d", er->esp_tls_last_esp_err, -er->esp_tls_stack_err, er->esp_transport_sock_errno, HTM_FW_VERSION, (unsigned)ESP.getFreeHeap(), (unsigned)ESP.getMaxAllocHeap(), (int)bleConnected);
    else if (er->error_type == MQTT_ERROR_TYPE_CONNECTION_REFUSED) status("CLOUD refused by the broker, code %d", (int)er->connect_return_code);
    else status("CLOUD error type %d", (int)er->error_type);
  } else if (id == MQTT_EVENT_DATA && e->data_len > 0 && e->data_len < 200 && e->topic_len > 0) {
    char body[200]; memcpy(body, e->data, e->data_len); body[e->data_len] = 0;
    if (e->topic_len >= 4 && !strncmp(e->topic + e->topic_len - 4, "/cmd", 4)) {
      long s = jsonNum(body, "\"sens\"", 0);
      if (s >= 1 && s <= 5) { char c[8]; snprintf(c, sizeof c, "!sens %ld", s); htmCoreCommand(c); }
    } else {                                          // viewer
      bool watching = strstr(body, "\"watching\":true") != nullptr;
      watchUntil = watching ? (uint64_t)jsonNum(body, "\"until\"", 0) : 0;
    }
  }
}
void cloudBegin() {
  snprintf(tTel, sizeof tTel, "%stelemetry", HTM_TOPIC_PREFIX);
  snprintf(tEvt, sizeof tEvt, "%sevent", HTM_TOPIC_PREFIX);
  snprintf(tSta, sizeof tSta, "%sstatus", HTM_TOPIC_PREFIX);
  snprintf(tCmd, sizeof tCmd, "%scmd", HTM_TOPIC_PREFIX);
  snprintf(tView, sizeof tView, "%sviewer", HTM_TOPIC_PREFIX);
  esp_mqtt_client_config_t mc = {};
  static char uri[160];
  snprintf(uri, sizeof uri, "mqtts://%s:8883", HTM_IOT_ENDPOINT);
  mc.broker.address.uri = uri;
  mc.broker.verification.certificate = HTM_ROOT_CA;
  mc.credentials.client_id = HTM_THING_NAME;
  mc.credentials.authentication.certificate = HTM_DEVICE_CERT;
  mc.credentials.authentication.key = HTM_PRIVATE_KEY;
  mc.session.keepalive = 60;
  mc.session.last_will.topic = tSta;
  mc.session.last_will.msg = "{\"v\":1,\"online\":false}";
  mc.session.last_will.msg_len = 0;
  mc.session.last_will.qos = 1;
  mc.session.last_will.retain = 1;
  mc.network.reconnect_timeout_ms = 5000;
  mc.buffer.size = 1024;
  mc.buffer.out_size = 1024;
  mqtt = esp_mqtt_client_init(&mc);
  esp_mqtt_client_register_event(mqtt, MQTT_EVENT_ANY, onMqtt, nullptr);
  esp_mqtt_client_start(mqtt);
  status("CLOUD connecting as %s (free heap %u, largest block %u)", HTM_THING_NAME, (unsigned)ESP.getFreeHeap(), (unsigned)ESP.getMaxAllocHeap());
}
void emit(void *, int kind, const char *json) {
  if (kind == htm::MSG_TELEMETRY) { publish(tTel, json, 0, false); return; }
  // events wait in a small queue until the connection is up (oldest dropped when full)
  strncpy(evq[(evHead + evCount) % kEvq].json, json, sizeof evq[0].json - 1);
  evq[(evHead + evCount) % kEvq].json[sizeof evq[0].json - 1] = 0;
  if (evCount < kEvq) evCount++; else evHead = (evHead + 1) % kEvq;
}
void pumpEvents() {
  while (cloudUp && evCount > 0) { publish(tEvt, evq[evHead].json, 1, false); evHead = (evHead + 1) % kEvq; evCount--; }
}
#else
void emit(void *, int, const char *) {}
#endif

// ---------------- task ----------------
void task(void *) {
  uint32_t lastWsCheck = 0, nBle = 0, lastInfo = 0, lastAdvCheck = 0;
  float accMax = 0, accMin = 99;
  for (;;) {
    HtmFrame f;
    if (xQueueReceive(frameQ, &f, pdMS_TO_TICKS(20)) == pdTRUE) {
      // BLE with a small MTU cannot carry 50 lines/s: send every 5th and merge the |a| extremes of the rest.
      if (f.aMax > accMax) accMax = f.aMax;
      if (f.aMin < accMin) accMin = f.aMin;
      bool bleSlow = bleConnected && bleMtu < 100;
      bool sendBle = bleConnected && (!bleSlow || (++nBle % 5) == 0);
      char line[200];
      int n = 0;
      const bool wsClients = wsStarted && ws.connectedClients() > 0;
      if (sendBle || wsClients) {
        HtmFrame g = f;
        if (bleSlow) { g.aMax = accMax; g.aMin = accMin; }
        n = htmFormatFrame(line, sizeof line, g);
        if (sendBle) bleSend(line, n);
      }
      if (sendBle) { accMax = 0; accMin = 99; }
      if (n > 0 && wsClients) ws.broadcastTXT(line, n);
      if (timeSet) {
        uint64_t now = epochMs();
        if (!reporterOn) {
          reporter.begin(now, emit, nullptr);
          reporterOn = true;
#if HTM_HAVE_CLOUD
          reporter.boot(now, HTM_FW_VERSION, tzMin);
#endif
        }
        reporter.push(f, now);
      }
    }
    char sb[kStatus];
    while (xQueueReceive(statusQ, sb, 0) == pdTRUE) {
      size_t n = strlen(sb);
      bleSend(sb, n);
      if (wsStarted && ws.connectedClients() > 0) ws.broadcastTXT(sb, n);
    }
    bleFlush();
    if (WiFi.status() == WL_CONNECTED && !wsStarted) { ws.begin(); ws.onEvent(wsEvent); wsStarted = true; status("WS listening on ws://%s:%d", WiFi.localIP().toString().c_str(), HTM_WS_PORT); }
    if (wsStarted) ws.loop();

    uint32_t ms = millis();
    if (WiFi.status() == WL_CONNECTED) {
      reporter.setRssi(WiFi.RSSI());
      if (!timeSet && time(nullptr) > 1704067200) { timeSet = true; status("TIME synchronised"); }
      if (ms - lastWsCheck > 5000) { lastWsCheck = ms; }
    }
#if HTM_HAVE_CLOUD
    const bool netOk = timeSet && WiFi.status() == WL_CONNECTED;
    switch (cloudPhase) {
      case CL_IDLE:
      case CL_WAIT:
        if (netOk && (cloudPhase == CL_IDLE || (int32_t)(ms - cloudDeadline) >= 0)) {
          bleStop();
          if (!mqtt) cloudBegin(); else esp_mqtt_client_start(mqtt);
          cloudDeadline = ms + 30000; cloudPhase = CL_TRY;
        }
        break;
      case CL_TRY:
        if (cloudUp) { cloudPhase = CL_UP; bleBegin(); status("BLE back on (free heap %u)", (unsigned)ESP.getFreeHeap()); }
        else if ((int32_t)(ms - cloudDeadline) >= 0) {
          esp_mqtt_client_stop(mqtt); bleBegin();
          cloudDeadline = ms + 60000; cloudPhase = CL_WAIT;
          status("CLOUD not reachable: Bluetooth back on, trying again in 60 s");
        }
        break;
      case CL_UP:
        if (!cloudUp) { bleStop(); cloudDeadline = ms + 30000; cloudPhase = CL_TRY; }
        break;
    }
    if (cloudUp) {
      pumpEvents();
      uint64_t now = epochMs();
      reporter.setPeriod(watchUntil > now ? 1 : 5);
      if (ms - lastHeartbeat > 900000UL) publishStatus(true);
    }
#endif
    if (bleOn && !bleConnected && ms - lastAdvCheck > 5000) {
      lastAdvCheck = ms;
      if (!NimBLEDevice::getAdvertising()->isAdvertising()) { status("BLE was not advertising: restarting"); bleAdvertise(); }
    }
    // "I'm OK" button: answers a fall countdown
    if (reporterOn && reporter.fallWaiting() && digitalRead(HTM_OK_BUTTON_PIN) == LOW) reporter.fallOutcome(epochMs(), "cancelled");
    if (ms - lastInfo > 60000 && (bleConnected || (wsStarted && ws.connectedClients()))) { lastInfo = ms; info(); }
  }
}

}  // namespace lnk

// ---------------- API used by the sketch ----------------
void htmLinkBegin() {
  uint8_t mac[6]; esp_read_mac(mac, ESP_MAC_BT);
#if HTM_HAVE_CLOUD
  snprintf(lnk::devName, sizeof lnk::devName, "HeadTremor-%02X%02X", mac[4], mac[5]);
#else
  snprintf(lnk::devName, sizeof lnk::devName, "HeadTremor-%02X%02X", mac[4], mac[5]);
#endif
  pinMode(HTM_OK_BUTTON_PIN, INPUT_PULLUP);
  lnk::frameQ = xQueueCreate(64, sizeof(HtmFrame));
  lnk::statusQ = xQueueCreate(8, lnk::kStatus);
  lnk::prefs.begin("htm", false);
  lnk::ssid = lnk::prefs.getString("ssid", "");
  lnk::pass = lnk::prefs.getString("pass", "");
  lnk::tzMin = lnk::prefs.getInt("tz", 330);
  lnk::bleBegin();
  if (lnk::ssid.length()) lnk::connectWifi();
  Serial.printf("# LINK Bluetooth \"%s\", WebSocket port %d, Wi-Fi %s, cloud %s\n", lnk::devName, HTM_WS_PORT, lnk::ssid.length() ? "configured" : "not set (send !wifi)", HTM_HAVE_CLOUD ? "provisioned" : "off");
  xTaskCreatePinnedToCore(lnk::task, "link", 12288, nullptr, 1, nullptr, 0);
}
inline void htmLinkPush(const HtmFrame &f) { if (lnk::frameQ && xQueueSend(lnk::frameQ, &f, 0) != pdTRUE) lnk::dropped++; }
inline void htmLinkStatus(const char *fmt, ...) {
  char b[lnk::kStatus]; b[0] = '#'; b[1] = ' ';
  va_list ap; va_start(ap, fmt); vsnprintf(b + 2, sizeof b - 3, fmt, ap); va_end(ap);
  size_t n = strlen(b); b[n] = '\n'; b[n + 1] = 0;
  Serial.print(b);
  if (lnk::statusQ) xQueueSend(lnk::statusQ, b, 0);
}
inline void htmLinkCommand(const char *line) { lnk::handle(line, true); }
inline void htmLinkSensitivity(int level) { if (lnk::reporterOn) lnk::reporter.setSensitivity(lnk::epochMs(), level); }
